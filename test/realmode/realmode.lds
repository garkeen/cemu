/* kvm-unit-tests x86/realmode.lds (GPLv2, v86/tests/kvm-unit-tests), extended
   for the mingw toolchain: the insn sections generated by MK_INSN and the PE
   .rdata section are placed explicitly instead of left to orphan handling. */
SECTIONS
{
    . = 16K;
    stext = .;
    .text : { *(.init) *(.text.insn) *(.text) }
    . = ALIGN(4K);
    .data : { *(.data) *(.data.insn) *(.rdata*) *(.rodata*) }
    . = ALIGN(16);
    .bss : { *(.bss) }
    edata = .;
}
ENTRY(start)
